// scale.ino — HX711 + CZL611N on Arduino Mega
// Library: HX711 by Bogdan Necula (install via Library Manager)

#include <HX711.h>
#include <math.h>

const int DOUT_PIN   = 3;
const int SCK_PIN    = 2;
const int BUZZER_PIN = 8;

HX711 scale;

// Measured at startup to cancel the constant offset introduced by correction_weight().
float zero_correction_g = 0.0f;

// ── Calibration ──────────────────────────────────────────────
// After uploading, open Serial Monitor at 115200 baud.
// Place a known weight and read the raw value, then:
//   calibration_factor = raw_reading / known_weight_in_grams
// Replace the value below with your result.
float calibration_factor = 646.5;   // <-- adjust this
const float CAPACITY_G = 1000.0;
const int AVG_SAMPLES = 8;       // hardware average: more samples → less raw noise
const int LOOP_DELAY_MS = 100;

// Filter parameters — tune after running record_zero_drift.py
const float EMA_ALPHA  = 0.23f;  // measured noise std ≈ 0.087 g; 0.5 balances lag vs noise
const int   MED_N      = 5;     // median window (must be odd, 3–9)

// 4th-order calibration: weight = f(sensor_output)
const float POLY_A4 =  2.3222629e-12;
const float POLY_A3 = -2.1376726e-10;
const float POLY_A2 = -2.0776874e-06;
const float POLY_A1 = 0.99711933;
const float POLY_A0 =  0.011400161;

float calibrated_weight(float x) {
  return ((((POLY_A4 * x + POLY_A3) * x + POLY_A2) * x + POLY_A1) * x + POLY_A0);
}

// ── Correction polynomial (generated by interactive_calibration.py) ──────────
const float CORR_A4 = -4.038726222e-12f;
const float CORR_A3 =  3.803357929e-09f;
const float CORR_A2 = -6.355544816e-07f;
const float CORR_A1 =  1.001230991f;
const float CORR_A0 = -0.08763373116f;

float correction_weight(float x) {
  return ((((CORR_A4 * x + CORR_A3) * x + CORR_A2) * x + CORR_A1) * x + CORR_A0);
}
// ─────────────────────────────────────────────────────────────────────────────

// Stage 1: median filter — rejects spike outliers
// Stage 2: EMA — smooths residual noise
// No deadband, no zero-tracking: tare() handles the zero at startup.
float filter_weight(float grams) {
  // ── Median (circular buffer) ──────────────────────────────
  static float buf[MED_N];
  static int   head  = 0;
  static int   count = 0;

  buf[head] = grams;
  head = (head + 1) % MED_N;
  if (count < MED_N) count++;

  // insertion-sort a copy to find the median
  float sorted[MED_N];
  for (int i = 0; i < count; i++) sorted[i] = buf[i];
  for (int i = 1; i < count; i++) {
    float k = sorted[i];
    int j = i - 1;
    while (j >= 0 && sorted[j] > k) { sorted[j + 1] = sorted[j]; j--; }
    sorted[j + 1] = k;
  }
  float med = sorted[count / 2];

  // ── EMA on median output ──────────────────────────────────
  static bool  ema_init = false;
  static float ema      = 0.0f;
  if (!ema_init) { ema = med; ema_init = true; }
  else           { ema = EMA_ALPHA * med + (1.0f - EMA_ALPHA) * ema; }

  return ema;
}


void setup() {
  Serial.begin(115200);
  scale.begin(DOUT_PIN, SCK_PIN);
  scale.set_scale(calibration_factor);
  scale.tare(20); // zero out on power-up

  pinMode(BUZZER_PIN, OUTPUT);
  Serial.println("ZEROING");

  // Warm up median buffer + EMA, then average the second half as zero reference.
  // SCALE MUST BE EMPTY during startup.
  const int WARMUP_N = 60;
  float sum = 0.0f;
  for (int i = 0; i < WARMUP_N; i++) {
    while (!scale.is_ready()) delay(5);
    float g = correction_weight(filter_weight(calibrated_weight(scale.get_units(AVG_SAMPLES))));
    if (i >= WARMUP_N / 2) sum += g;   // only use second half (filter settled)
    delay(LOOP_DELAY_MS);
  }
  zero_correction_g = sum / (WARMUP_N / 2);

  Serial.println("READY");
}

void loop() {
  if (scale.is_ready()) {
    float grams_raw = scale.get_units(AVG_SAMPLES);
    float grams_cal = calibrated_weight(grams_raw);
    float grams_disp = correction_weight(filter_weight(grams_cal)) - zero_correction_g;

    if (grams_disp > CAPACITY_G) {
      tone(BUZZER_PIN, 2000);
    } else {
      noTone(BUZZER_PIN);
    }

    // W,<filtered_g>,<raw_cal_g>
    // raw_cal: after calibration poly, before filter — for noise comparison
    Serial.print("W,");
    Serial.print(grams_disp, 2);
    Serial.print(",");
    Serial.println(grams_cal, 2);
  }
  delay(LOOP_DELAY_MS);
}